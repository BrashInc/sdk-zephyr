## boards/arm/orion_nrf9160/Kconfig.board
```kconfig
# Orion nRF9160 board configuration
#
# Copyright (c) 2019 Nordic Semiconductor ASA
#
# SPDX-License-Identifier: LicenseRef-BSD-5-Clause-Nordic

if SOC_NRF9160_SICA

config BOARD_ORION_NRF9160
	bool "nRF9160 ORION"

config BOARD_ORION_NRF9160NS
	bool "nRF9160 ORION non-secure"

endif # SOC_NRF9160_SICA
```

## drivers/led/Kconfig.lp500x
```kconfig
# Copyright (c) 2020 Seagate Technology LLC
# SPDX-License-Identifier: Apache-2.0

config LP500X
	bool "LP500X LED controller"
	depends on I2C
	help
	  Enable driver for the Texas Instruments LP5009 and LP5012 I2C LED
	  controllers. They are respectively supporting up to 9 and 12 LEDs.
```

## dts/bindings/led/ti,lp500x.yaml
```yaml
# Copyright (c) 2020 Seagate Technology LLC
# SPDX-License-Identifier: Apache-2.0
#
# Modifid by Brash Inc (2020)

description: TI LP500x LED controller node

compatible: "ti,lp500x"

include: ["i2c-device.yaml", "led-controller.yaml"]

properties:
    max_curr_opt:
      type: boolean
      required: false
      description: |
        If enabled the maximum current output is set to 35 mA (25.5 mA else).
    log_scale_en:
      type: boolean
      required: false
      description: |
        If enabled a logarithmic dimming scale curve is used for LED brightness
        control. A linear dimming scale curve is used else.
    en_gpios:
      type: phandle-array
      required: false
      description: |
        This property specifies the enable pin mapping

child-binding:
    properties:
        label:
          required: true
        index:
          required: true
        color-mapping:
          required: true
```
